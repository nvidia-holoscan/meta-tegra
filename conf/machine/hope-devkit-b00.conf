## conf/machine/hope-devkit-b00.conf
```bitbake
#@TYPE: Machine
#@NAME: NVIDIA Hope Devkit (b00)
#@DESCRIPTION: NVIDIA Hope Developer Kit (b00)

require conf/machine/include/tegra234.inc
require conf/machine/include/devkit-wifi.inc

NVPMODEL = "nvpmodel_p3701_0002"
NVFANCONTROL = "nvfancontrol_p3701_0002"

# Extracted from l4t_generate_soc_bup.sh for BOARDID=3701 and board=hope-devkit
TEGRA_BUPGEN_SPECS ?= "fab=000;boardsku=0002;boardrev="
KERNEL_DEVICETREE ?= "tegra234-p3701-0002-p3740-0002.dtb"
KERNEL_ARGS ?= "mminit_loglevel=4 console=tty0 console=ttyTCU0,115200 firmware_class.path=/etc/firmware fbcon=map:0 net.ifnames=0"

EMMC_SIZE ?= "31276924928"
EMMC_DEVSECT_SIZE ?= "512"
BOOTPART_SIZE ?= "8388608"
BOOTPART_LIMIT ?= "10485760"
ROOTFSPART_SIZE ?= "30064771072"
ODMDATA ?= "gbe-uphy-config-6,hsio-uphy-config-0,nvhs-uphy-config-0"
EMMC_BCT ?= "tegra234-p3701-0002-p3740-0002-ta990sa-sdram.dts"
NVIDIA_BOARD ?= "t186ref"
PARTITION_LAYOUT_TEMPLATE ?= "flash_t234_qspi_sdmmc.xml"
TEGRA_AUDIO_DEVICE ?= "tegra-hda-jetson-agx"

BPF_FILE ?= "bpmp_t234-TA990SA-A1_prod.bin"
BPFDTB_FILE ?= "tegra234-bpmp-3701-0002-3740-0002.dtb"
TBCDTB_FILE ?= "tegra234-p3701-0002-p3740-0002.dtb"
OVERLAY_DTB_FILE ?= "${TEGRA_BOOTCONTROL_OVERLAYS},tegra234-p3737-audio-codec-rt5658-40pin.dtbo"

TEGRA_FAB = "TS1"
TEGRA_BOARDSKU = "0002"
```

## conf/machine/hope-devkit-b01.conf
```bitbake
#@TYPE: Machine
#@NAME: NVIDIA Hope Devkit (b01)
#@DESCRIPTION: NVIDIA Hope Developer Kit (b01)

require conf/machine/hope-devkit-b00.conf

KERNEL_DEVICETREE = "tegra234-p3701-0002-p3740-0002-b01.dtb"
ODMDATA = "gbe-uphy-config-8,hsio-uphy-config-0,nvhs-uphy-config-0"
BPFDTB_FILE = "tegra234-bpmp-3701-0002-3740-0002-b01.dtb"
TBCDTB_FILE = "tegra234-p3701-0002-p3740-0002-b01.dtb"
```
